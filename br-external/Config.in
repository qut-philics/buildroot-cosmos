## br-external/Config.in
```kconfig
source "$BR2_EXTERNAL_QUT_PATH/package/bitstream-timestamp/Config.in"
source "$BR2_EXTERNAL_QUT_PATH/package/configpl/Config.in"
source "$BR2_EXTERNAL_QUT_PATH/package/cosmos-i2cconfig/Config.in"
source "$BR2_EXTERNAL_QUT_PATH/package/zrproc/Config.in"
source "$BR2_EXTERNAL_QUT_PATH/package/zynq-mkbootimage/Config.in.host"
```

## br-external/package/bitstream-timestamp/Config.in
```kconfig
config BR2_PACKAGE_BITSTREAM_TIMESTAMP
    bool "bitstream-timestamp"
    help
        Prints timestamp encoded into FPGA bitstream. 
```

## br-external/package/configpl/Config.in
```kconfig
config BR2_PACKAGE_CONFIGPL
    bool "configpl"
    help
        ConfigPL utillity for Zynq-7000 devices. 
		
		Configures Zynq-7000 FPGA using Xilinx bitstream (in .bin format) via the Linux FPGA Manager. 
```

## br-external/package/cosmos-i2cconfig/Config.in
```kconfig
config BR2_PACKAGE_COSMOS_I2CCONFIG
    bool "cosmos-i2cconfig"
    help
        Configures I2C peripherals of Cosmos XZQ10 board. 
		
		Routes clkgen0 to GTX.
		Enables all SFP transceivers.
		Selects LEDs and DIP switches.
```

## br-external/package/pacpwm-config/Config.in
```kconfig
config BR2_PACKAGE_PACPWM_CONFIG
    bool "pacpwm-config"
	depends on BR2_PACKAGE_HOST_RUSTC_TARGET_ARCH_SUPPORTS
	select BR2_PACKAGE_HOST_RUSTC
    help
        Utility for writing PACPWM configuration to shared OCM memory.
```

## br-external/package/philics-pl/Config.in
```kconfig
config BR2_PACKAGE_PHILICS_PL
    bool "philics-pl"
    help
        Programmable Logic (PL) bitstreams implementing PHiLICS applications.
		
		This package allows a user to select the PL bitstream which is to be
		loaded to the PL fabric by the FSBL on boot. The selected bitstream
		will be included in the boot.bin file produced by the post-image.sh 
		script provided by the QUT external tree (br-external/board/cosmos).
		
if BR2_PACKAGE_PHILICS_PL

choice
	prompt "bitstream"
	default BR2_PACKAGE_PHILICS_PL_PACPWM
	help
	  Select the bitstream to load at boot.

config BR2_PACKAGE_PHILICS_PL_PACPWM
	bool "pacpwm"
	help
	  Single-phase PACPWM modulator with configurable clock, phase increment,
	  and compare value.

config BR2_PACKAGE_PHILICS_PL_PHIL1PREGULAR
	bool "phil-1p-regular"
	help
	  Single-phase PHiL amplifier with asymetric regular sampling.
	  
config BR2_PACKAGE_PHILICS_PL_VSI1PREGMAF
	bool "vsi-1p-reg-maf"
	help
	  Single-phase VSI with synchronous sampling, MAFs for all measurements, 
	  and PWM using asymmetric regular sampling.

endchoice

endif
```

## br-external/package/zrproc-firmware/Config.in
```kconfig
config BR2_PACKAGE_ZRPROC_FIRMWARE
    bool "zrproc-firmware"
    help
        Baremetal firmware compiled for loading to CPU1 via zrproc.
		
		Typically implement real-time control applications.
```

## br-external/package/zrproc/Config.in
```kconfig
config BR2_PACKAGE_ZRPROC
    bool "zrproc"
    help
        Remoteproc utillity for Zynq-7000 devices. 
		
		Loads and runs an ELF file on a remote processor core.
```

## br-external/package/zynq-mkbootimage/Config.in.host
```kconfig
config BR2_PACKAGE_HOST_ZYNQ_MKBOOTIMAGE
	bool "host zynq-mkbootimage"
	help
	  This is an open-source replacement for the Xilinx bootgen 
	  application. The package provides sources of two binaries 
	  mkbootimage and exbootimage for both creation and extraction 
	  of Zynq boot images.

	  https://github.com/antmicro/zynq-mkbootimage
```
